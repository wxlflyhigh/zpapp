## CMakeLists.txt
```
# Copyright (c) 2024 Realtek Semiconductor Corp.
# SPDX-License-Identifier: Apache-2.0

cmake_minimum_required(VERSION 3.20.0)

find_package(Zephyr REQUIRED HINTS $ENV{ZEPHYR_BASE})
project(fatfs)

target_sources(app PRIVATE src/main.c)
# target_sources(app PRIVATE src/direct_fatfs.c)
```

## prj.conf
```kconfig
CONFIG_FILE_SYSTEM=y
CONFIG_FAT_FILESYSTEM_ELM=y

CONFIG_FILE_SYSTEM_MKFS=y
CONFIG_FS_FATFS_MOUNT_MKFS=y

# when select CONFIG_FAT_FILESYSTEM_ELM, DISK_ACCESS is auto selected by KConfig
# CONFIG_DISK_ACCESS=y

# must open CONFIG_DISK_DRIVER_FLASH, 
# otherwise fat fs mount failed
CONFIG_DISK_DRIVER_FLASH=y

CONFIG_LOG=y
CONFIG_LOG_MODE_IMMEDIATE=y
CONFIG_LOG_DEFAULT_LEVEL=3
CONFIG_FS_LOG_LEVEL_DBG=y

CONFIG_FLASH=y

#
# CONFIG_FLASH_MAP=y

# fix: Stack overflow, default=1024
CONFIG_MAIN_STACK_SIZE=8092
```

## app.overlay
```dts
/*
 * Copyright (c) 2022 Nordic Semiconductor ASA
 *
 * SPDX-License-Identifier: Apache-2.0
 */


&storage_partition {
	reg = <0x250000 DT_SIZE_K(64)>;
};

/ {
	test_disk: storage_disk {
		compatible = "zephyr,flash-disk";
		partition = <&storage_partition>;
		disk-name = "NAND";
		cache-size = <4096>;
	};
};
```

## src/main.c
```c
/*
 * Copyright (c) 2024 Realtek Semiconductor Corp.
 *
 * SPDX-License-Identifier: Apache-2.0
 */

#include <stdio.h>
#include <zephyr/logging/log.h>
#include <zephyr/fs/fs.h>
#include <zephyr/kernel.h>  // for k_msleep()

#include <ff.h>
// #include "os_wrapper.h"

#if 1
#if defined(CONFIG_DISK_DRIVER_FLASH)
#define DISK_NAME DT_PROP(DT_NODELABEL(test_disk), disk_name)
#else
#error "Failed to select DISK access type"
#endif
#else
#define DISK_NAME "NAND"
#endif

#define FATFS_MNTP	"/"DISK_NAME":"
#define TEST_FILE	FATFS_MNTP"/testfile.txt"
#define TEST_DIR	FATFS_MNTP"/testdir"
#define TEST_DIR_FILE	FATFS_MNTP"/testdir/testfile2.txt"

#include <zephyr/logging/log.h>
// LOG_MODULE_DECLARE(fs, CONFIG_FS_LOG_LEVEL);
LOG_MODULE_REGISTER(fatmain);

/* FatFs work area */
static FATFS fat_fs;

/* mounting info */
static struct fs_mount_t fatfs_mnt = {
	.type = FS_FATFS,
	.mnt_point = FATFS_MNTP,
	.fs_data = &fat_fs,
};

int main(void)
{
	k_msleep(1000);
	LOG_INF("run fatfs example\n");

	int ret;
	struct fs_file_t file;
	char read_buff[128];
	ssize_t brw;
	const char test_str[] = "Hello, FatFS on Flash!";
	size_t sz = strlen(test_str);

	LOG_INF("start to mount fatfs");
	ret = fs_mount(&fatfs_mnt);
	if (ret < 0) {
		LOG_INF("FAT file system mounting failed, [%d]\n", ret);
		goto err_ret;
	} else {
		LOG_INF("FAT file system mounting successfully\n");
	}

	LOG_INF("start to fs_file_t_init");
	fs_file_t_init(&file);
	LOG_INF("start to fs_open");
	ret = fs_open(&file, TEST_FILE, FS_O_CREATE | FS_O_RDWR);
	if (ret != 0) {
		LOG_INF("Error opening file: %s, (%d)\n", TEST_FILE, ret);
		goto err_unmount;
	} else {
		LOG_INF("open [%s] successfully\n", TEST_FILE);
	}

	// write
	LOG_INF("start to fs_write");
	ret = fs_write(&file, test_str, strlen(test_str));
	if (ret < 0) {
		LOG_INF("Error writing to file: %d\n", ret);
	}

	if (ret < strlen(test_str)) {
		LOG_INF("Unable to complete write. Volume full.\n");
	}
	LOG_INF("write date [%s] to file %s successfully. len:%d\n", test_str, TEST_FILE, ret);

	// read
	(void)fs_seek(&file, 0, FS_SEEK_SET);
	brw = fs_read(&file, read_buff, sz);
	if (brw < 0) {
		LOG_INF("Failed reading file [%zd]\n", brw);
		fs_close(&file);
		goto err_close;
	}

	read_buff[brw] = 0;

	if (strcmp(test_str, read_buff)) {
		LOG_INF("Error - Data read does not match data written\n");
		LOG_INF("Data read:\"%s\"\n\n", read_buff);
	} else {
		LOG_INF("Data read successfully. [%s]\n", read_buff);
	}

err_close:
	ret = fs_close(&file);
	if (ret != 0) {
		LOG_INF("Error closing file: %d\n", ret);
	} else {
		LOG_INF("close %s successfully\n", TEST_FILE);
	}

err_unmount:
	ret = fs_unmount(&fatfs_mnt);
	if (ret < 0) {
		LOG_INF("Error unmount FAT file system [%d]\n", ret);
	} else {
		LOG_INF("unmount FAT file system successfully\n");
	}

err_ret:
	return 1;
}
```

## src/direct_fatfs.c
```c
#include "ff.h"
#include <stdio.h>
#include <stdlib.h>

// diskio_linux.c 中写死了 pdrv 必须是0
// 对应 zephyr_fatfs_config.h 中的 FF_VOLUME_STRS，编号从0开始
#define MOUNT_PT "NAND:"
#define TESTFILE2 "test2.txt"


static int test_statvfs(void)
{
    FATFS fs;
    FIL fil;
    FRESULT fr;
    UINT bw;
    FILINFO fno;  // 文件信息结构体

    printf("FatFs Sample Application on Linux\n");

    /* 挂载文件系统 */
    fr = f_mount(&fs, MOUNT_PT, 1);
    if (fr != FR_OK) {
        printf("Mount failed: error %d\n", fr);
        return 1;
    }
    printf("File system mounted successfully.\n");

    /* 创建测试文件 */
    fr = f_open(&fil, TESTFILE2, FA_WRITE | FA_CREATE_ALWAYS);
    if (fr == FR_OK) {
        f_write(&fil, "Test content", 12, &bw);
        f_close(&fil);
        printf("Test file created.\n");
    } else {
        printf("open Test file (%s) failed.\n", TESTFILE2);
    }

    /* 使用f_stat获取文件状态 */
    printf("\n=== 使用f_stat获取文件状态 ===\n");
    
    fr = f_stat(TESTFILE2, &fno);
    if (fr == FR_OK) {
        printf("文件状态信息：\n");
        printf("  文件大小: %u 字节\n", fno.fsize);
        printf("  最后修改日期: %u-%u-%u\n", 
               (fno.fdate >> 9) + 1980,  // 年
               (fno.fdate >> 5) & 15,      // 月  
               fno.fdate & 31);              // 日
        printf("  最后修改时间: %u:%u:%u\n",
               fno.ftime >> 11,             // 时
               (fno.ftime >> 5) & 63,      // 分
               (fno.ftime & 31) * 2);       // 秒
        printf("  文件属性: ");
        if (fno.fattrib & AM_DIR) printf("目录 ");
        if (fno.fattrib & AM_RDO) printf("只读 ");
        if (fno.fattrib & AM_HID) printf("隐藏 ");
        if (fno.fattrib & AM_SYS) printf("系统 ");
        if (fno.fattrib & AM_ARC) printf("存档 ");
        printf("\n");
        
        // 长文件名支持（如果启用）
        #if FF_USE_LFN
        printf("  长文件名: %s\n", fno.fname);
        #else
        printf("  文件名: %s\n", fno.fname);
        #endif
    } else {
        printf("获取文件状态失败: 错误代码 %d\n", fr);
    }

    /* 检查不存在的文件 */
    printf("\n=== 检查不存在文件 ===\n");
    fr = f_stat("nonexistent.txt", &fno);
    if (fr == FR_NO_FILE) {
        printf("文件不存在，符合预期\n");
    } else {
        printf("不符合预期， fr=%d\n", fr);
    }

    /* 获取目录状态 */
    printf("\n=== 获取目录状态 ===\n");
    fr = f_stat("/", &fno);
    if (fr == FR_OK && (fno.fattrib & AM_DIR)) {
        printf("根目录状态获取成功\n");
    } else {
        printf("根目录状态获取失败， fr=%d\n", fr);
    }

    /* 卸载文件系统 */
    f_mount(NULL, "", 0);
    printf("File system unmounted.\n");

	return 0;
}

int test_normal_flow() {
    FATFS fs;
    FIL fil;
    FRESULT fr;
    UINT bw;

    printf("FatFs Sample Application on Linux\n");

    /* 挂载文件系统 */
    fr = f_mount(&fs, MOUNT_PT, 1);
    if (fr != FR_OK) {
        printf("Mount failed: error %d\n", fr);
        return 1;
    }
    printf("File system mounted successfully.\n");

    /* 创建并写入文件 */
    fr = f_open(&fil, "hello.txt", FA_WRITE | FA_CREATE_ALWAYS);
    if (fr == FR_OK) {
        fr = f_write(&fil, "Hello, FatFs!\n", 14, &bw);
        f_close(&fil);
        if (fr == FR_OK && bw == 14) {
            printf("File 'hello.txt' created and written.\n");
        }
    }

    /* 读取文件内容 */
    fr = f_open(&fil, "hello.txt", FA_READ);
    if (fr == FR_OK) {
        char buffer[64];
        fr = f_read(&fil, buffer, sizeof(buffer), &bw);
        f_close(&fil);
        if (fr == FR_OK) {
            buffer[bw] = '\0';
            printf("File content: %s", buffer);
        }
    }

    /* 列出目录内容 */
    DIR dir;
    FILINFO fno;
    
    printf("\nDirectory listing:\n");
    fr = f_opendir(&dir, "/");
    if (fr == FR_OK) {
        while (f_readdir(&dir, &fno) == FR_OK && fno.fname[0]) {
            printf("  %s\n", fno.fname);
        }
        f_closedir(&dir);
    }

    /* 卸载文件系统 */
    f_mount(NULL, "", 0);
    printf("File system unmounted.\n");

    return 0;
}

int main() {
    test_normal_flow();
    test_statvfs();
    return 0;
}
```

## src/ppt_main.c
```c
/*
 * Copyright (c) 2024 Realtek Semiconductor Corp.
 *
 * SPDX-License-Identifier: Apache-2.0
 */

#include <stdio.h>
#include <zephyr/logging/log.h>
#include <zephyr/fs/fs.h>
#include <zephyr/kernel.h>  // for k_msleep()

#include <ff.h>

#define DISK_NAME DT_PROP(DT_NODELABEL(test_disk), disk_name)

#define FATFS_MNTP	"/"DISK_NAME":"
#define TEST_FILE	FATFS_MNTP"/testfile.txt"
#define TEST_DIR	FATFS_MNTP"/testdir"
#define TEST_DIR_FILE	FATFS_MNTP"/testdir/testfile2.txt"

#include <zephyr/logging/log.h>
LOG_MODULE_DECLARE(fs, CONFIG_FS_LOG_LEVEL);

/* FatFs work area */
static FATFS fat_fs;

/* mounting info */
static struct fs_mount_t fatfs_mnt = {
	.type = FS_FATFS,
	.mnt_point = FATFS_MNTP,
	.fs_data = &fat_fs,
};

int main(void)
{
	k_msleep(1000);
	LOG_INF("run fatfs example\n");

	int ret;
	struct fs_file_t file;
	char read_buff[128];
	ssize_t brw;
	const char test_str[] = "Hello, FatFS on Flash!";
	size_t sz = strlen(test_str);

	ret = fs_mount(&fatfs_mnt);
	fs_file_t_init(&file);
	ret = fs_open(&file, TEST_FILE, FS_O_CREATE | FS_O_RDWR);

	// read previous write data, make sure they're read from flash
	(void)fs_seek(&file, 0, FS_SEEK_SET);
	memset(read_buff, 0, 128);
	brw = fs_read(&file, read_buff, sz);	
	read_buff[brw] = 0;

	if (!strcmp(test_str, read_buff)) {
		LOG_INF("Data read successfully. [%s]. len:%d\n", read_buff, brw);
	} else {
		LOG_ERR("Data read:[%s]. len:%d\n", read_buff, brw);
	}

	// write
	ret = fs_write(&file, test_str, strlen(test_str));
	LOG_INF("write date [%s] to file %s successfully. len:%d\n", test_str, TEST_FILE, ret);

#if 0
	// read
	(void)fs_seek(&file, 0, FS_SEEK_SET);
	brw = fs_read(&file, read_buff, sz);

	read_buff[brw] = 0;

	if (!strcmp(test_str, read_buff)) {
		LOG_INF("Data read successfully. [%s]\n", read_buff);
	}
#endif

err_close:
	ret = fs_close(&file);

err_unmount:
	ret = fs_unmount(&fatfs_mnt);


err_ret:
	return 1;
}
```
