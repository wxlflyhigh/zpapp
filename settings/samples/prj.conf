## prj.conf
```kconfig
CONFIG_STDOUT_CONSOLE=y

# settings is already enabled default in boards/realtek/rtl8721f_evb/rtl8721f_evb_defconfig
# use ZMS backend
# CONFIG_FLASH=y
# CONFIG_FLASH_MAP=y
# CONFIG_SETTINGS=y
# CONFIG_NVS=y
# CONFIG_SETTINGS_NVS=y

# fix: undefined reference to `settings_runtime_get'
CONFIG_SETTINGS_RUNTIME=y

# when both NVS and ZMS are enabled, only ZMS works.
# CONFIG_ZMS=y
# CONFIG_SETTINGS_ZMS=y

CONFIG_HEAP_MEM_POOL_SIZE=256
CONFIG_MPU_ALLOW_FLASH_WRITE=y

CONFIG_LOG=y
CONFIG_LOG_MODE_IMMEDIATE=y

# we should set log levels with _DBG suffix
CONFIG_SETTINGS_LOG_LEVEL_DBG=y
# CONFIG_NVS_LOG_LEVEL_DBG=y
# CONFIG_ZMS_LOG_LEVEL_DBG=y
# CONFIG_FLASH_LOG_LEVEL_DBG=y

# fix stack overflow
# <err> os: >>> ZEPHYR FATAL ERROR 2: Stack overflow on CPU 0
# <err> os: Current thread: 0x20008138 (main)
CONFIG_MAIN_STACK_SIZE=4096
```

## src/main.c
```c
/*
 * Copyright (c) 2019 Nordic Semiconductor ASA
 *
 * SPDX-License-Identifier: Apache-2.0
 */

/*
键名					值类型		值长度
alpha/beta/voltage		int			4
alpha/beta/source		char[]
alpha/angle/1
alpha/length/1
alpha/length/2
*/
#include <stdio.h>
#include <string.h>

#include <zephyr/settings/settings.h>

#include <errno.h>
#include <zephyr/sys/printk.h>

#if defined(CONFIG_SETTINGS_FILE)
#include <zephyr/fs/fs.h>
#include <zephyr/fs/littlefs.h>
#endif

#include <zephyr/logging/log.h>
LOG_MODULE_REGISTER(stmain);

// 当后端是文件系统时使用 storage_partition
#define STORAGE_PARTITION	storage_partition
#define STORAGE_PARTITION_ID	FIXED_PARTITION_ID(STORAGE_PARTITION)

#define GAMMA_DEFAULT_VAl 0
#define FAIL_MSG "fail (err %d)\n"
#define SECTION_BEGIN_LINE \
	"\n=================================================\n"

#define LOOP_NUMS (1)

/* Default values are assigned to settings values consuments
 * All of them will be overwritten if storage contain proper key-values
 */
uint8_t angle_val;
uint64_t length_val = 100;
uint16_t length_1_val = 40;
uint32_t length_2_val = 60;
int32_t voltage_val = -3000;
char source_name_val[6] = "";

int alpha_handle_set(const char *name, size_t len, settings_read_cb read_cb,
		  void *cb_arg);
int alpha_handle_commit(void);
int alpha_handle_export(int (*cb)(const char *name,
			       const void *value, size_t val_len));

int beta_handle_set(const char *name, size_t len, settings_read_cb read_cb,
		  void *cb_arg);
int beta_handle_commit(void);
int beta_handle_export(int (*cb)(const char *name,
			       const void *value, size_t val_len));
int beta_handle_get(const char *name, char *val, int val_len_max);

/* dynamic main tree handler */
struct settings_handler alpha_handler = {
		.name = "alpha",
		.h_get = NULL,
		.h_set = alpha_handle_set,
		.h_commit = alpha_handle_commit,
		.h_export = alpha_handle_export
};

/* static subtree handler */
SETTINGS_STATIC_HANDLER_DEFINE(beta, "alpha/beta", beta_handle_get,
			       beta_handle_set, beta_handle_commit,
			       beta_handle_export);

int alpha_handle_set(const char *name, size_t len, settings_read_cb read_cb,
		  void *cb_arg)
{
	const char *next;
	size_t next_len;
	int rc;
	LOG_INF("[%s] %s, %d.", __func__, name, len);

	if (settings_name_steq(name, "angle/1", &next) && !next) {
		if (len != sizeof(angle_val)) {
			return -EINVAL;
		}
		rc = read_cb(cb_arg, &angle_val, sizeof(angle_val));
		LOG_INF("<alpha/angle/1> = %d\n", angle_val);
		return 0;
	}

	next_len = settings_name_next(name, &next);

	if (!next) {
		return -ENOENT;
	}

	if (!strncmp(name, "length", next_len)) {
		next_len = settings_name_next(name, &next);

		if (!next) {
			rc = read_cb(cb_arg, &length_val, sizeof(length_val));
			LOG_INF("<alpha/length> = %" PRId64 "\n", length_val);
			return 0;
		}

		if (!strncmp(next, "1", next_len)) {
			rc = read_cb(cb_arg, &length_1_val,
				     sizeof(length_1_val));
			LOG_INF("<alpha/length/1> = %d\n", length_1_val);
			return 0;
		}

		if (!strncmp(next, "2", next_len)) {
			rc = read_cb(cb_arg, &length_2_val,
				     sizeof(length_2_val));
			LOG_INF("<alpha/length/2> = %d\n", length_2_val);
			return 0;
		}

		return -ENOENT;
	}

	return -ENOENT;
}

int beta_handle_set(const char *name, size_t len, settings_read_cb read_cb,
		  void *cb_arg)
{
	const char *next;
	size_t name_len;
	int rc;
	LOG_INF("[%s] %s, %d.", __func__, name, len);

	name_len = settings_name_next(name, &next);

	if (!next) {
		if (!strncmp(name, "voltage", name_len)) {
			rc = read_cb(cb_arg, &voltage_val, sizeof(voltage_val));
			LOG_INF("<alpha/beta/voltage> = %d\n", voltage_val);
			return 0;
		}

		if (!strncmp(name, "source", name_len)) {
			if (len > sizeof(source_name_val) - 1) {
				LOG_INF("<alpha/beta/source> is not compatible "
				       "with the application\n");
				return -EINVAL;
			}
			rc = read_cb(cb_arg, source_name_val,
				     sizeof(source_name_val));
			if (rc < 0) {
				return rc;
			} else if (rc > 0) {
				LOG_INF("<alpha/beta/source> = %s\n",
				       source_name_val);
			}
			return 0;
		}
	}

	return -ENOENT;
}

int alpha_handle_commit(void)
{
	LOG_INF("[%s]", __func__);

	LOG_INF("loading all settings under <alpha> handler is done\n");
	return 0;
}

/**
 * @brief 
 * 
 * @param cb : pointer to settings_save_one
 * @return int 
 */
int alpha_handle_export(int (*cb)(const char *name,
			       const void *value, size_t val_len))
{
	LOG_INF("[%s]", __func__);

	LOG_INF("export keys under <alpha> handler\n");
	(void)cb("alpha/angle/1", &angle_val, sizeof(angle_val));
	(void)cb("alpha/length", &length_val, sizeof(length_val));
	(void)cb("alpha/length/1", &length_1_val, sizeof(length_1_val));
	(void)cb("alpha/length/2", &length_2_val, sizeof(length_2_val));

	return 0;
}

int beta_handle_export(int (*cb)(const char *name,
			       const void *value, size_t val_len))
{
	LOG_INF("[%s]", __func__);
	LOG_INF("export keys under <beta> handler\n");
	(void)cb("alpha/beta/voltage", &voltage_val, sizeof(voltage_val));
	(void)cb("alpha/beta/source", source_name_val, strlen(source_name_val) +
						       1);

	return 0;
}

int beta_handle_commit(void)
{
	LOG_INF("[%s]", __func__);
	LOG_INF("loading all settings under <beta> handler is done\n");
	return 0;
}

int beta_handle_get(const char *name, char *val, int val_len_max)
{
	const char *next;
	LOG_INF("[%s] %s, val=%s, maxlen=%d.", __func__, name, val, val_len_max);

	if (settings_name_steq(name, "source", &next) && !next) {
		val_len_max = MIN(val_len_max, strlen(source_name_val));
		memcpy(val, source_name_val, val_len_max);
		return val_len_max;
	}

	return -ENOENT;
}

static void example_save_and_load_basic(void)
{
	int i, rc;
	int32_t val_s32;

	LOG_INF(SECTION_BEGIN_LINE);
	LOG_INF("basic load and save using registered handlers\n");
	/* load all key-values at once
	 * In case a key-value doesn't exist in the storage
	 * default values should be assigned to settings consuments variable
	 * before any settings load call
	 */
	/** settings_load() 依次触发了以下回调
	 * beta_handle_set 多次; name: voltage, source;
	 * alpha_handle_set 多次; name: angle/1, length/1, length/2;
	 * beta_handle_commit 一次
	 * alpha_handle_commit 一次
	*/
	LOG_INF("\nload all key-value pairs using registered handlers\n");
	settings_load();

	val_s32 = voltage_val - 25;
	/* save certain key-value directly*/
	LOG_INF("\nsave <alpha/beta/voltage> key directly: ");
	rc = settings_save_one("alpha/beta/voltage", (const void *)&val_s32,
			       sizeof(val_s32));
	if (rc) {
		LOG_INF(FAIL_MSG, rc);
	}

	LOG_INF("OK.\n");

	/** settings_load_subtree("alpha/beta") 依次触发了以下回调
	 * beta_handle_set 多次; name: voltage, source;
	 * beta_handle_commit 一次
	 */
	LOG_INF("\nload <alpha/beta> key-value pairs using registered "
	       "handlers\n");
	settings_load_subtree("alpha/beta");

	/* save only modified values
	 * or those that were not saved
	 * before
	 */
	i = strlen(source_name_val);
	if (i < sizeof(source_name_val) - 1) {
		source_name_val[i] = 'a' + i;
		source_name_val[i + 1] = 0;
	} else {
		source_name_val[0] = 0;
	}

	angle_val += 1;

	/** settings_save() 依次触发了以下回调
	 * beta_handle_export 一次
	 * 		在 beta_handle_export 中，用户主动调用 cb=settings_save_one 真正去存储数据。
	 * alpha_handle_export 一次
	 * 		在 alpha_handle_export 中，用户主动调用 cb=settings_save_one 真正去存储数据。
	 */
	LOG_INF("\nsave all key-value pairs using registered handlers\n");
	settings_save();

	if (++length_1_val > 100) {
		length_1_val = 0;
	}

	if (--length_2_val > 100) {
		length_2_val = 100;
	}

	/*---------------------------
	 * save only modified values
	 * or those that were deleted
	 * before
	 */
	LOG_INF("\nload all key-value pairs using registered handlers\n");
	settings_save();
}

struct direct_length_data {
	uint64_t length;
	uint16_t length_1;
	uint32_t length_2;
};

static int direct_loader(const char *name, size_t len, settings_read_cb read_cb,
			  void *cb_arg, void *param)
{
	const char *next;
	size_t name_len;
	int rc;
	struct direct_length_data *dest = (struct direct_length_data *)param;

	LOG_INF("direct load: %s. len=%d", name, len);

	name_len = settings_name_next(name, &next);

	if (name_len == 0) {
		rc = read_cb(cb_arg, &(dest->length), sizeof(dest->length));
		LOG_INF("<alpha/length>\n");
		return 0;
	}

	name_len = settings_name_next(name, &next);
	if (next) {
		LOG_INF("nothing\n");
		return -ENOENT;
	}

	if (!strncmp(name, "1", name_len)) {
		rc = read_cb(cb_arg, &(dest->length_1), sizeof(dest->length_1));
		LOG_INF("<alpha/length/1>\n");
		return 0;
	}

	if (!strncmp(name, "2", name_len)) {
		rc = read_cb(cb_arg, &(dest->length_2), sizeof(dest->length_2));
		LOG_INF("<alpha/length/2>\n");
		return 0;
	}

	LOG_INF("nothing\n");
	return -ENOENT;
}

static void example_direct_load_subtree(void)
{
	struct direct_length_data dld;
	int rc;

	/* load subtree directly using call-specific handler `direct_loader'
	 * This handler loads subtree values to call-specific structure of type
	 * 'direct_length_data`.
	 */
	LOG_INF(SECTION_BEGIN_LINE);
	LOG_INF("loading subtree to destination provided by the caller\n\n");
	rc = settings_load_subtree_direct("alpha/length", direct_loader,
					  (void *)&dld);
	if (rc == 0) {
		LOG_INF("  direct.length = %" PRId64 "\n", dld.length);
		LOG_INF("  direct.length_1 = %d\n", dld.length_1);
		LOG_INF("  direct.length_2 = %d\n", dld.length_2);
	} else {
		LOG_INF("  direct load fails unexpectedly\n");
	}
}

struct direct_immediate_value {
	size_t len;
	void *dest;
	uint8_t fetched;
};

static int direct_loader_immediate_value(const char *name, size_t len,
					 settings_read_cb read_cb, void *cb_arg,
					 void *param)
{
	const char *next;
	size_t name_len;
	int rc;
	struct direct_immediate_value *one_value =
					(struct direct_immediate_value *)param;

	LOG_INF("[%s] name=%s, len=%d", __func__, name, len);

	name_len = settings_name_next(name, &next);

	if (name_len == 0) {
		if (len == one_value->len) {
			rc = read_cb(cb_arg, one_value->dest, len);
			if (rc >= 0) {
				one_value->fetched = 1;
				LOG_INF("immediate load: OK.\n");
				return 0;
			}

			LOG_INF(FAIL_MSG, rc);
			return rc;
		}
		return -EINVAL;
	}

	/* other keys aren't served by the callback
	 * Return success in order to skip them
	 * and keep storage processing.
	 */
	return 0;
}

int load_immediate_value(const char *name, void *dest, size_t len)
{
	int rc;
	struct direct_immediate_value dov;

	dov.fetched = 0;
	dov.len = len;
	dov.dest = dest;

	rc = settings_load_subtree_direct(name, direct_loader_immediate_value,
					  (void *)&dov);
	if (rc == 0) {
		if (!dov.fetched) {
			rc = -ENOENT;
		}
	}

	return rc;
}

static void example_without_handler(void)
{
	uint8_t val_u8;
	int rc;

	LOG_INF(SECTION_BEGIN_LINE);
	LOG_INF("Service a key-value pair without dedicated handlers\n\n");
	rc = load_immediate_value("gamma", &val_u8, sizeof(val_u8));
	if (rc == -ENOENT) {
		val_u8 = GAMMA_DEFAULT_VAl;
		LOG_INF("<gamma> = %d (default)\n", val_u8);
	} else if (rc == 0) {
		LOG_INF("<gamma> = %d\n", val_u8);
	} else {
		LOG_INF("unexpected"FAIL_MSG, rc);
	}

	val_u8++;

	LOG_INF("save <gamma> key directly: ");
	rc = settings_save_one("gamma", (const void *)&val_u8,
			       sizeof(val_u8));
	if (rc) {
		LOG_INF(FAIL_MSG, rc);
	} else {
		LOG_INF("OK.\n");
	}
}

static void example_initialization(void)
{
	int rc;

#if defined(CONFIG_SETTINGS_FILE)
	FS_LITTLEFS_DECLARE_DEFAULT_CONFIG(cstorage);

	/* mounting info */
	static struct fs_mount_t littlefs_mnt = {
	.type = FS_LITTLEFS,
	.fs_data = &cstorage,
	.storage_dev = (void *)STORAGE_PARTITION_ID,
	.mnt_point = "/ff"
	};

	rc = fs_mount(&littlefs_mnt);
	if (rc != 0) {
		LOG_INF("mounting littlefs error: [%d]\n", rc);
	} else {

		rc = fs_unlink(CONFIG_SETTINGS_FILE_PATH);
		if ((rc != 0) && (rc != -ENOENT)) {
			LOG_INF("can't delete config file%d\n", rc);
		} else {
			LOG_INF("FS initialized: OK\n");
		}
	}
#endif

	rc = settings_subsys_init();
	if (rc) {
		LOG_INF("settings subsys initialization: fail (err %d)\n", rc);
		return;
	}

	LOG_INF("settings subsys initialization: OK.\n");

	rc = settings_register(&alpha_handler);
	if (rc) {
		LOG_INF("subtree <%s> handler registered: fail (err %d)\n",
		       alpha_handler.name, rc);
	}

	LOG_INF("subtree <%s> handler registered: OK\n", alpha_handler.name);
	LOG_INF("subtree <alpha/beta> has static handler\n");
}

static void example_delete(void)
{
	uint64_t val_u64;
	int rc;

	LOG_INF(SECTION_BEGIN_LINE);
	LOG_INF("Delete a key-value pair\n\n");

	rc = load_immediate_value("alpha/length", &val_u64, sizeof(val_u64));
	if (rc == 0) {
		LOG_INF("  <alpha/length> value exist in the storage\n");
	}

	LOG_INF("delete <alpha/length>: ");
	rc = settings_delete("alpha/length");
	if (rc) {
		LOG_INF(FAIL_MSG, rc);
	} else {
		LOG_INF("OK.\n");
	}

	rc = load_immediate_value("alpha/length", &val_u64, sizeof(val_u64));
	if (rc == -ENOENT) {
		LOG_INF("  Can't to load the <alpha/length> value as "
		       "expected\n");
	}
}

void example_runtime_usage(void)
{
	int rc;
	uint8_t injected_str[sizeof(source_name_val)] = "RT";

	LOG_INF(SECTION_BEGIN_LINE);
	LOG_INF("Inject the value to the setting destination in runtime\n\n");

	rc = settings_runtime_set("alpha/beta/source", (void *) injected_str,
				  strlen(injected_str) + 1);

	LOG_INF("injected <alpha/beta/source>: ");
	if (rc) {
		LOG_INF(FAIL_MSG, rc);
	} else {
		LOG_INF("OK.\n");
	}

	LOG_INF("  The settings destination off the key <alpha/beta/source> has "
	       "got value: \"%s\"\n\n", source_name_val);

	/* set settings destination value "by hand" for next example */
	(void) strcpy(source_name_val, "rtos");

	LOG_INF(SECTION_BEGIN_LINE);
	LOG_INF("Read a value from the setting destination in runtime\n\n");

	rc = settings_runtime_get("alpha/beta/source", (void *) injected_str,
				  strlen(injected_str) + 1);
	LOG_INF("fetched <alpha/beta/source>: ");
	if (rc < 0) {
		LOG_INF(FAIL_MSG, rc);
	} else {
		LOG_INF("OK.\n");
	}

	LOG_INF("  String value \"%s\" was retrieved from the settings "
	       "destination off the key <alpha/beta/source>\n",
	       source_name_val);
}

int main(void)
{

	int i;

	LOG_INF("\n*** Settings usage example ***\n\n");

	/* settings initialization */
	example_initialization();

	for (i = 0; i < LOOP_NUMS; i++) {
		LOG_INF("\n##############\n");
		LOG_INF("# iteration %d", i);
		LOG_INF("\n##############\n");

		/*---------------------------------------------
		 * basic save and load using registered handler
		 */
		example_save_and_load_basic();

		/*-------------------------------------------------
		 *load subtree directly using call-specific handler
		 */
		example_direct_load_subtree();

		/*-------------------------
		 * delete certain key-value
		 */
		example_delete();

		/*---------------------------------------
		 * a key-value without dedicated handler
		 */
		example_without_handler();
	}

	/*------------------------------------------------------
	 * write and read settings destination using runtime API
	 */
	example_runtime_usage();

	LOG_INF("\n*** THE END  ***\n");
	return 0;
}
```
